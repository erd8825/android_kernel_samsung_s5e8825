/*
 * SAMSUNG A53X board device tree source
 *
 * Copyright (c) 2026 Samsung Electronics Co., Ltd.
 *		http://www.samsung.com
 *
 * This program is free software; you can redistribute it and/or modify
 * it under the terms of the GNU General Public License version 2 as
 * published by the Free Software Foundation.
 */

#include "s5e8825.a53x_common.dtsi"
#include "s5e8825-a53x_pm_00.dtsi"
#include "camera/s5e8825-a53x-camera_02.dtsi"

/ {
	fragment@model {
		target-path = "/";
		__overlay__ {
			model = "Samsung A53X EUR OPEN REV02 based on S5E8825";
		}; /* end of __overlay__ */
	}; /* end of fragment */
}; /* end of root */

&serial_0 {
	status = "okay";
};

&dwmmc_2 {
	card-detect-invert;
};
